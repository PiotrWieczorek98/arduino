/**
 * MIDI-Arduino Sequencing code translator
 * Courtesy of http://greenlightgo.org/projects/midi-to-arduino/
 **/

/********************************
 * sequence.h
 ********************************/
#ifndef SEQUENCE_H
#define SEQUENCE_H

#include <Servo.h>

class Sequence {
  protected:
    int index;
    int pin;
    int length;
    long lastEventTimestamp;
    const unsigned int* eventDeltas;
  
    virtual void doEvent();

  public:
    Sequence(const int pin, const int length, const unsigned int* eventDeltas);
    void update(const long time);
    virtual void init();
};

class DigitalSequence : public Sequence{  
  protected:
    void doEvent();

  public:
    DigitalSequence(const int pin, const int length, const unsigned int* eventDeltas);
    void init();

};

class ToneSequence : public Sequence{
  protected:
    const unsigned int* notes;    
    void doEvent();
    
  public:
    ToneSequence(const int pin, const int length, const unsigned int* eventDeltas, const unsigned int* notes);
    void init();
};

class ServoSequence : public Sequence{
  protected:
    Servo servo;    
    const byte* angles;
    void doEvent();
    
  public:
    ServoSequence(const int pin, const int length, const unsigned int* eventDeltas, const uint8_t* angles);
    void init();
};

class PWMSequence : public Sequence{
  protected:
    const byte* values;
    void doEvent();
    
  public:
    PWMSequence(const int pin, const int length, const unsigned int* eventDeltas, const uint8_t* values);
    void init();
};

#endif

/********************************
 * sequence.cpp
 ********************************/
// Sequence implementations
Sequence::Sequence(const int pin, const int length, const unsigned int* eventDeltas){
  pinMode(pin, OUTPUT);
  this->pin = pin;
  this->length = length;
  this->index = 0;
  this->lastEventTimestamp = 0l;
  
  this->eventDeltas = eventDeltas;
}

void Sequence::update(const long time){
  while(index < length){
    unsigned int nextTimestamp = pgm_read_word_near(eventDeltas+index);
    if((time - lastEventTimestamp) > nextTimestamp){
      this->doEvent();
      lastEventTimestamp += nextTimestamp;
      index++;
    }else{
      break;
    }
  }
}

void Sequence::init(){}
void Sequence::doEvent(){}


// DigitalSequence implementations
DigitalSequence::DigitalSequence(const int pin, const int length, const unsigned int* eventDeltas) : Sequence(pin, length, eventDeltas){
  pinMode(pin, OUTPUT);
}
    
void DigitalSequence::init(){
  pinMode(pin, OUTPUT);
}

void DigitalSequence::doEvent(){
  digitalWrite(pin, (this->index + 1)%2);
}


// ToneSequence implementations
ToneSequence::ToneSequence(const int pin, const int length, const unsigned int* eventDeltas, const unsigned int* notes) : Sequence(pin, length, eventDeltas){
  this->notes = notes;
}

void ToneSequence::init(){
  pinMode(pin, OUTPUT);
}

void ToneSequence::doEvent(){
  if(index % 2 == 1){
    noTone(pin);
  }else{
    tone(pin, pgm_read_word_near(notes+index/2));
  }
}


// ServoSequence implementations
ServoSequence::ServoSequence(const int pin, const int length, const unsigned int* eventDeltas, const uint8_t* angles) : Sequence(pin, length, eventDeltas){
  this->angles = angles;
}

void ServoSequence::init(){
  this->servo.attach(pin);
}

void ServoSequence::doEvent(){
  byte angle = pgm_read_byte_near(angles+index);
  servo.write(angle);
}


// PWMSequence implementations
PWMSequence::PWMSequence(const int pin, const int length, const unsigned int* eventDeltas, const uint8_t* values) : Sequence(pin, length, eventDeltas){
  this->values = values;
}

void PWMSequence::init(){
  pinMode(pin, OUTPUT);
}

void PWMSequence::doEvent(){
  byte value = pgm_read_byte_near(values+index);
  analogWrite(pin, value);
}


#define TRACK_COUNT 1

const PROGMEM unsigned int DELTAS_3[] = {96, 48, 0, 48, 0, 48, 0, 72, 24, 48, 0, 48, 0,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 48, 0};
const PROGMEM unsigned int NOTES_3[] = {247, 220, 247, 294, 220, 247, 220, 247, 294, 220, 247, 294, 587,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 110, 55};


Sequence* tracks[TRACK_COUNT] = {
  new ToneSequence(3, 1578, DELTAS_3, NOTES_3),
};


void setup(){
  for(int i=0; i<TRACK_COUNT; i++){
    tracks[i]->init();
  }
}

void loop(){
  long timestamp = millis();
  for(int i=0; i<TRACK_COUNT; i++){
    tracks[i]->update(timestamp * 0.3);
  }
}
